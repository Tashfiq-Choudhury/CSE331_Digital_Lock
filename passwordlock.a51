ORG 0H
RS EQU P2.3 //dedicated pin for RS pin of lcd
RW EQU P2.4 //dedicated pin for RW pin of lcd
E EQU p2.5 //dedicated pin for enable pin of lcd

;; INITIALIZING PORTS FOR KEYPAD
MOV A, #0FFH //MAKING INPUT PORT
MOV P0, A
MOV A, #0H//MAKING OUTPUT PORT
MOV P2, A

MAIN:
MOV DPTR, #COMAND1 //LOCATION OF LCD INITIALIZATION VALUES
ACALL SEND_CMD //INITIALIZE LCD TO SEND DATA
ACALL DELAY //WAIT SO COMMANDS ARE WRITTEN
MOV DPTR, #TEXT1
ACALL SEND_DATA // NOW SENDING WHAT WE WANT TO SHOW
ACALL DELAY //WAITING FOR DATA TO BE WRITTEN

MOV DPTR, #COMAND1 //LOCATION OF LCD INITIALIZATION VALUES
ACALL SEND_CMD //INITIALIZE LCD TO SEND DATA
ACALL DELAY //WAIT SO COMMANDS ARE WRITTEN
MOV DPTR, #TEXT2
ACALL SEND_DATA //NOW SEND WHAT WE WANT TO SHOW
ACALL DELAY //WAIT SO DATA IS WRITTEN

MOV DPTR, #COMAND2 //LOCATION OF LCD INITIALIZATION VALUES
ACALL SEND_CMD //INITIALZIE LCD TO SEND DATA
ACALL DELAY //WAIT SO COMMANDS ARE WRITTEN
MOV DPTR, #TEXT3
ACALL SEND_DATA //NOW SEND WHAT WE WANT TO SHOW
ACALL DELAY //WAIT SO DATA IS WRITTEN

MOV DPTR, #COMAND1 //LOCATION OF LCD INITIALIZATION VALUES
ACALL SEND_CMD//INITIALIZE LCD TO SEND DATA
ACALL DELAY
MOV DPTR, #TEXT4
ACALL SEND_DATA
ACALL DELAY

//KEYPAD ENTER PASSWORD
MOV DPTR, #COMAND2
ACALL SEND_CMD
ACALL DELAY
MOV R2,#7
MOV R0,#40H
LOOP1:
CLR A
LJMP KEYPAD
VAL_KEYPAD:
MOV @R0,A
MOV A,#42
ACALL DATAWRITE
ACALL DELAY
ACALL DELAY
INC R0
DJNZ R2,LOOP1

///END KEYPAD

///CHECKING PASSWORD START
MOV DPTR, #COMAND1 //
ACALL SEND_CMD //
ACALL DELAY //
MOV DPTR, #CHKMSG
ACALL SEND_DATA
ACALL DELAY
CLR A
MOV R1,#40H
MOV R2,#7
MOV DPTR,#PASS1
PLOOP1:
CLR A
MOVC A,@A+DPTR
MOV B,@R1
CJNE A,B,INVALID1
INC DPTR
INC R1
DJNZ R2,PLOOP1
SJMP MATCHED1
INVALID1:

CLR A
MOV R1,#40H
MOV R2,#7
MOV DPTR, #PASS2
PLOOP2:
CLR A
MOVC A,@A+DPTR
MOV B,@R1
CJNE A,B,INVALID2
INC DPTR
INC R1
DJNZ R2,PLOOP2
SJMP MATCHED2
/// CHECKING PASSWORD ENDS


///INVALID AND DENIED
INVALID2:
MOV DPTR, #COMAND1
ACALL SEND_CMD
ACALL DELAY
MOV DPTR, #TEXT_F1
ACALL SEND_DATA
ACALL DELAY
MOV DPTR, #COMAND2
ACALL SEND_CMD
ACALL DELAY
MOV DPTR, #TEXT_F2
ACALL SEND_DATA
ACALL DELAY
CLR P3.1
CLR P3.0 //STOP MOTOR
LJMP MAIN

///CLOCKWISE LOCKED
MATCHED1:
MOV DPTR, #COMAND1
ACALL SEND_CMD
ACALL DELAY
MOV DPTR, #TEXT_S1
ACALL SEND_DATA
ACALL DELAY
MOV DPTR,#COMAND1
ACALL SEND_CMD
ACALL DELAY
MOV DPTR, #TEXT_S2
ACALL SEND_DATA
ACALL DELAY
SETB P3.0 // CLOCKWISE DIRECTION OF MOTOR
CLR P3.1
SJMP LOOP

///ANTICLOCKWISE UNLOCKED
MATCHED2:
MOV DPTR, #COMAND1
ACALL SEND_CMD
ACALL DELAY
MOV DPTR, #TEXT_S1
ACALL SEND_DATA
ACALL DELAY
MOV DPTR, #COMAND1
ACALL SEND_CMD
ACALL DELAY
MOV DPTR, #TEXT_S3
ACALL SEND_DATA
ACALL DELAY
CLR P3.0 //ANTICLOCKWISE DIRECTION OF MOTOR
SETB P3.1
SJMP LOOP
///DESCISION ENDS


LOOP: SJMP LOOP


//// KEYPAD CODE
KEYPAD:
	;CHECKING COLUMN1
	SETB P2.0
	SETB P2.1
	SETB P2.2
	ACALL DELAY_1S
	CLR P2.0
	SETB P2.1
	SETB P2.2
	JB P0.0, W1
	LCALL DETECTED_1
	LJMP VAL_KEYPAD
W1:
	JB P0.1, X1
	LCALL DETECTED_4
	LJMP VAL_KEYPAD
X1:
	JB P0.2, Z1
	LCALL DETECTED_7
	LJMP VAL_KEYPAD

Z1:
SETB P2.0
	CLR P2.1
	SETB P2.2
	JB P0.0, W2
	LCALL DETECTED_2
	LJMP VAL_KEYPAD
W2:  JB P0.1, X2
	LCALL DETECTED_5
	LJMP VAL_KEYPAD
X2: JB P0.2, Y2
	LCALL DETECTED_8
	LJMP VAL_KEYPAD
Y2: JB P0.3, Z2
	LCALL DETECTED_0
	LJMP VAL_KEYPAD
	;CHECKING COLUMN 3
Z2:
	SETB P2.0
	SETB P2.1
	CLR P2.2
	JB P0.0, W3
	LCALL DETECTED_3
	LJMP VAL_KEYPAD
W3: JB P0.1, X3
	LCALL DETECTED_6
	LJMP VAL_KEYPAD
X3:	JB P0.2, Z3
	LCALL DETECTED_9
	LJMP VAL_KEYPAD
Z3:
LJMP KEYPAD

DETECTED_0:
CLR A
	MOV A,#0
	LCALL DELAY_1S
	LCALL DELAY_1S
LCALL DELAY_1S
LCALL DELAY_1S
LCALL DELAY_1S
	RET
DETECTED_1:
CLR A
	MOV A,#1
	LCALL DELAY_1S
	LCALL DELAY_1S
LCALL DELAY_1S
LCALL DELAY_1S
LCALL DELAY_1S
	RET
DETECTED_2:
CLR A
	MOV A,#2
	LCALL DELAY_1S
	LCALL DELAY_1S
LCALL DELAY_1S
LCALL DELAY_1S
LCALL DELAY_1S
	RET
DETECTED_3:
CLR A
MOV A,#3
LCALL DELAY_1S
LCALL DELAY_1S
LCALL DELAY_1S
LCALL DELAY_1S
LCALL DELAY_1S
	RET
DETECTED_4:
CLR A
MOV A,#4
LCALL DELAY_1S
LCALL DELAY_1S
LCALL DELAY_1S
LCALL DELAY_1S
LCALL DELAY_1S
	RET
DETECTED_5:
	CLR A
	MOV A,#5
LCALL DELAY_1S
LCALL DELAY_1S
LCALL DELAY_1S
LCALL DELAY_1S
LCALL DELAY_1S
	RET
DETECTED_6:
	MOV A,#6
LCALL DELAY_1S
LCALL DELAY_1S
LCALL DELAY_1S
LCALL DELAY_1S
LCALL DELAY_1S
	RET
DETECTED_7:
CLR A
	MOV A,#7
	LCALL DELAY_1S
LCALL DELAY_1S
LCALL DELAY_1S
LCALL DELAY_1S
LCALL DELAY_1S
	RET
DETECTED_8:
	CLR A
	MOV A,#8
	LCALL DELAY_1S
LCALL DELAY_1S
LCALL DELAY_1S
LCALL DELAY_1S
	LCALL DELAY_1S
	RET
DETECTED_9:
	CLR A
	MOV A,#9
	LCALL DELAY_1S
LCALL DELAY_1S
LCALL DELAY_1S
LCALL DELAY_1S
	LCALL DELAY_1S
	RET

DELAY_1S:            ;DELAY OF 1S
MOV R3,#255 ;
HERE2: MOV R4,#255
HERE: DJNZ R4,HERE ; STAY UNITL R4 BECOMES 0
DJNZ R3,HERE2
RET


SEND_CMD:

GO2:CLR A
	MOVC A, @A+DPTR
	ACALL COMWRITE
	ACALL DELAY
	INC DPTR
	JZ OUT
	SJMP GO2
	OUT:
RET

SEND_DATA:
GO3:CLR A
	MOVC A, @A+DPTR
	ACALL DATAWRITE
	ACALL DELAY
	INC DPTR
	JZ HERE1
	SJMP GO3
HERE1:
	RET



;LCD CODE STARTING
COMWRITE:
	MOV P1, A
	CLR RS
	CLR RW
	SETB E
	ACALL DELAY
	CLR E
	RET
DATAWRITE:
	MOV P1,A
	SETB RS
	CLR RW
	SETB E
	ACALL DELAY
	CLR E
	RET
DELAY:
	MOV R3,#250
XX2: MOV R4,#255
XX1: DJNZ R4,XX1
	DJNZ R3,XX2
	RET

ORG 400H
COMAND1: DB 38H,0EH,01H,06H,0
COMAND2: DB 38H,0EH,06H,0C0H,0
TEXT1: DB "PASSWORD BASED",0
TEXT2: DB "DIGITAL LOCK",0
TEXT3: DB "SAFETY SYSTEM",0
TEXT4: DB "ENTER PASSWORD",0
CHKMSG: DB "PROCESSING....",0
TEXT_S1: DB "ACCESS - GRANTED",0
TEXT_S2: DB "----LOCKED----",0
TEXT_S3: DB "---UNLOCKED---",0
TEXT_F1: DB "WRONG PASSWORD",0
TEXT_F2: DB "ACCESS DENIED",0
PASS1: DB 1,1,1,1,1,1,1
PASS2: DB 0,0,0,0,0,0,0
END